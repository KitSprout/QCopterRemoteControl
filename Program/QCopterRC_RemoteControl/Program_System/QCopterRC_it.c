/*=====================================================================================================*/
/*=====================================================================================================*/
#include "stm32f4_system.h"
#include "stm32f4_sdio.h"
#include "module_nrf24l01.h"
/*=====================================================================================================*/
/*=====================================================================================================*/
void SysTick_Handler( void )
{
}
/*=====================================================================================================*/
/*=====================================================================================================*/
void EXTI9_5_IRQHandler( void )
{
  if(EXTI_GetITStatus(EXTI_Line7) != RESET) {
    nRF_Recv_IRQ();
    EXTI_ClearITPendingBit(EXTI_Line7);
  }
}
/*=====================================================================================================*/
/*=====================================================================================================*/
void SDIO_IRQHandler( void )
{
  SD_ProcessIRQSrc();
}
/*=====================================================================================================*/
/*=====================================================================================================*/
void DMA2_Stream3_IRQHandler( void )
{
  SD_ProcessDMAIRQ();
}
/*=====================================================================================================*/
/*=====================================================================================================*/
void HardFault_Handler( void )
{
  while(1);
}
void MemManage_Handler( void )
{
  while(1);
}
void BusFault_Handler( void )
{
  while(1);
}
void UsageFault_Handler( void )
{
  while(1);
}
void SVC_Handler( void )
{
  while(1);
}
void DebugMon_Handler( void )
{
  while(1);
}
void PendSV_Handler( void )
{
  while(1);
}
void NMI_Handler( void )
{
  while(1);
}
/*=====================================================================================================*/
/*=====================================================================================================*/
